## build/conf/local.conf
```bitbake
BBFILES = "${HOME}/OE/openembedded/recipes/*/*.bb"
BBFILES += "${HOME}/OE/local/recipies/*/*.bb"
BBFILE_COLLECTIONS = "overlay"
BBFILE_PATTERN_overlay = "${HOME}/OE/local"
BBFILE_PRIORITY_overlay = 20

DL_DIR = "${HOME}/sources"
BBMASK = ""

PREFERRED_PROVIDERS = "virtual/qte:qte virtual/libqpe:libqpe-opie"
PREFERRED_PROVIDERS += " virtual/libsdl:libsdl-x11"
PREFERRED_PROVIDERS += " virtual/${TARGET_PREFIX}gcc-initial:gcc-cross-initial"
PREFERRED_PROVIDERS += " virtual/${TARGET_PREFIX}gcc-intermediate:gcc-cross-intermediate"
PREFERRED_PROVIDERS += " virtual/${TARGET_PREFIX}gcc:gcc-cross"
PREFERRED_PROVIDERS += " virtual/${TARGET_PREFIX}g++:gcc-cross"

MACHINE = "ebox3300"

TARGET_OS = "linux"

DISTRO = "minimal"

IMAGE_FSTYPES = "jffs2 tar.gz cpio.gz"

PARALLEL_MAKE = "-j 4"
BB_NUMBER_THREADS = "2"

BBINCLUDELOGS = "yes"

OE_STRICT_CHECKSUMS = ""
```

## local/conf/machine/ebox3300.conf
```bitbake
#@TYPE: Machine
#@NAME: ebox3300

require conf/machine/include/tune-i486sx.inc

MACHINE_FEATURES += "kernel26 alsa usbgadget usbhost vfat x86"

KERNEL_IMAGETYPE = "bzImage"

PREFERRED_PROVIDER_virtual/kernel = "linux"


MACHINE_EXTRA_RDEPENDS = "r6040"
MACHINE_EXTRA_RRECOMMENDS = "kernel-module-r6040"

#GLIBC_ADDONS = "nptl"
#GLIBC_EXTRA_OECONF = "--with-tls"
```
